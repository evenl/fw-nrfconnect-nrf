## drivers/at_cmd/Kconfig
```kconfig
#
# Copyright (c) 2019 Nordic Semiconductor
#
# SPDX-License-Identifier: LicenseRef-BSD-5-Clause-Nordic
#

menu "AT command interface driver"

config AT_CMD_INTERFACE
	bool "AT Command interface driver"
	depends on BSD_LIBRARY

if AT_CMD_INTERFACE

config AT_CMD_THREAD_PRIO
	int "Thread priority level"
	range 0 NUM_PREEMPT_PRIORITIES
	default 0 if !MULTITHREADING
	default 10

config AT_CMD_RESPONSE_MAX_LEN
	int "Maximum AT command response length"
	default 256

module = AT_CMD_INTERFACE
module-str = AT command interface driver
source "${ZEPHYR_BASE}/subsys/logging/Kconfig.template.log_config"

endif # AT_CMD_INTERFACE

endmenu
```
