## CMakeLists.txt
```
#
# Copyright (c) 2019 Nordic Semiconductor
#
# SPDX-License-Identifier: LicenseRef-BSD-5-Clause-Nordic
#

cmake_minimum_required(VERSION 3.8.2)

include($ENV{ZEPHYR_BASE}/cmake/app/boilerplate.cmake NO_POLICY_SCOPE)
project(AT_CMD_PARSER)

target_sources(app PRIVATE src/main.c)
```

## prj.conf
```kconfig
CONFIG_STDOUT_CONSOLE=y
CONFIG_LOG=y
CONFIG_LOG_DEFAULT_LEVEL=4
CONFIG_HEAP_MEM_POOL_SIZE=2048
CONFIG_MAIN_STACK_SIZE=4096

CONFIG_AT_CMD_PARSER=y
```

## src/main.c
```c
/*
 * Copyright (c) 2019 Nordic Semiconductor ASA
 *
 * SPDX-License-Identifier: LicenseRef-BSD-5-Clause-Nordic
 */

#include <zephyr.h>
#include <at_cmd_parser/at_cmd_decoder.h>

char *cereg_str = "+CEREG: 2,\"76C1\",\"0102DA04\",7";
char *cesq_str1 = "%CESQ: 62,3";
char *cesq_str2 = "+CESQ: 99,99,255,255,255,62";
char *cmt_str   = "+CMT: \"+4797664513\", 24\r\n"
		  "06917429000171040A91747966543100009160402143708006C8329BFD0601";

struct at_cmd_decoder sample_decoder;

void process_model(void *model_ptr, void *model)
{
	static u32_t count;

	printk("------Message %04d-------\n", count++);

	switch ((enum at_cmd_models)model) {
	case AT_CMD_CEREG_MODEL:
		printk("CEREG Stat: %d\n",
			((struct at_cmd_model_cereg *)model_ptr)->stat);
		printk("CEREG TAC:  %s\n",
			((struct at_cmd_model_cereg *)model_ptr)->tac);
		printk("CEREG CI:   %s\n",
			((struct at_cmd_model_cereg *)model_ptr)->ci);
		printk("CEREG Act:  %d\n",
			((struct at_cmd_model_cereg *)model_ptr)->act);
		break;
	case AT_CMD_CMT_MODEL:
		printk("CMT Origin number: %s\n",
			((struct at_cmd_model_cmt *)model_ptr)->sender_addr);
		printk("CMT PDU lenght: %d\n",
			((struct at_cmd_model_cmt *)model_ptr)->pdu_length);
		printk("CMT PDU payload: %s\n",
			((struct at_cmd_model_cmt *)model_ptr)->pdu_data);
		break;
	case AT_CMD_CESQ_MODEL:
		printk("CESQ Rxlev: %d\n",
			((struct at_cmd_model_cesq *)model_ptr)->rxlev);
		printk("CESQ ber:   %d\n",
			((struct at_cmd_model_cesq *)model_ptr)->ber);
		printk("CESQ rscp:  %d\n",
			((struct at_cmd_model_cesq *)model_ptr)->rscp);
		printk("CESQ ecno:  %d\n",
			((struct at_cmd_model_cesq *)model_ptr)->ecno);
		printk("CESQ rsrq:  %d\n",
			((struct at_cmd_model_cesq *)model_ptr)->rsrq);
		printk("CESQ rsrp:  %d\n",
			((struct at_cmd_model_cesq *)model_ptr)->rsrp);
		break;
	case AT_NOT_CESQ_MODEL:
		printk("Notification CESQ rsrp: %d\n",
			((struct at_not_model_cesq *)model_ptr)->rsrp);
		printk("Notification CESQ threshold index: %d\n",
			((struct at_not_model_cesq *)
				model_ptr)->threshold_index);
		break;
	default:
		break;
	}

	printk("-------------------------\n");
}

void main(void)
{
	printk("The AT command parser sample started\n");

	at_cmd_decoder_init(&sample_decoder, NULL, 0);
	at_cmd_decoder_set_handler(&sample_decoder, process_model);

	at_cmd_decode(&sample_decoder, cereg_str);
	at_cmd_decode(&sample_decoder, cesq_str1);
	at_cmd_decode(&sample_decoder, cesq_str2);
	at_cmd_decode(&sample_decoder, cmt_str);
}
```
